## drivers/gpu/drm/panel/msm8974-generated/Kconfig
```kconfig
menu "MSM8974 panel drivers generated with linux-mdss-dsi-panel-driver-generator"
	depends on GPIOLIB && OF && REGULATOR
	depends on DRM_MIPI_DSI

config DRM_PANEL_MSM8974_GENERATED
	tristate "Select all generated MSM8974 panel drivers by default"

config DRM_PANEL_FAIRPHONE_FP2_OTM1902B
	tristate "Fairphone FP2 OTM1902B"
	default DRM_PANEL_MSM8974_GENERATED

config DRM_PANEL_FAIRPHONE_FP2_S6D6FA1
	tristate "Fairphone FP2 S6D6FA1"
	default DRM_PANEL_MSM8974_GENERATED

config DRM_PANEL_SONY_LEO_NOVATEK_LGD
	tristate "Sony LEO NOVATEK LGD"
	default DRM_PANEL_MSM8974_GENERATED

config DRM_PANEL_SONY_ARIES_TOSHIBA_720P_VIDEO
	tristate "Sony Aries toshiba 720p video"
	default DRM_PANEL_MSM8974_GENERATED

config DRM_PANEL_SONY_ARIES_NOVATEK_DEFAULT_0
	tristate "Sony Aries novatek default 0"
	default DRM_PANEL_MSM8974_GENERATED

config DRM_PANEL_SONY_ARIES_NOVATEK_DEFAULT_1
	tristate "Sony Aries novatek default 1"
	default DRM_PANEL_MSM8974_GENERATED

config DRM_PANEL_SONY_ARIES_NOVATEK_JDI
	tristate "Sony Aries novatek jdi"
	default DRM_PANEL_MSM8974_GENERATED

config DRM_PANEL_SONY_ARIES_NOVATEK_SHARP
	tristate "Sony Aries novatek sharp"
	default DRM_PANEL_MSM8974_GENERATED

endmenu
```
